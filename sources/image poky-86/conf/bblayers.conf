## sources/image poky-86/conf/bblayers.conf
```bitbake
# POKY_BBLAYERS_CONF_VERSION is increased each time build/conf/bblayers.conf
# changes incompatibly
POKY_BBLAYERS_CONF_VERSION = "2"

BBPATH = "${TOPDIR}"
BBFILES ?= ""

BBLAYERS ?= " \
  /home/alonso/Documents/TEC/II_SEMESTRE_25/embed/project1/Customized-operating-system-for-multimedia-applications-with-Yocto-Project/sources/poky-x86/meta \
  /home/alonso/Documents/TEC/II_SEMESTRE_25/embed/project1/Customized-operating-system-for-multimedia-applications-with-Yocto-Project/sources/poky-x86/meta-poky \
  /home/alonso/Documents/TEC/II_SEMESTRE_25/embed/project1/Customized-operating-system-for-multimedia-applications-with-Yocto-Project/sources/poky-x86/meta-yocto-bsp \
  "
```
